VERSION ""

NS_ :

BS_:

BU_:

BO_ 3221225472 VECTOR__INDEPENDENT_SIG_MSG: 0 Vector__XXX
 SG_ APPS_old : 0|16@1+ (1,0) [0|0] "" Vector__XXX
 SG_ Brake : 0|16@1+ (1,0) [0|100] "" Vector__XXX
 SG_ Steering : 0|16@1- (1,0) [0|0] "" Vector__XXX

BO_ 2281701504 apps: 2 Vector__XXX
 SG_ apps : 0|16@1+ (1,0) [0|100] "%" Vector__XXX

BO_ 2218983424 inverter3_status: 8 Vector__XXX
 SG_ speed : 0|16@1+ (1,0) [0|0] "rpm" Vector__XXX

BO_ 2281767040 bse: 2 Vector__XXX
 SG_ bse : 0|16@1+ (1,0) [0|100] "%" Vector__XXX

BO_ 2281832576 sps: 2 Vector__XXX
 SG_ sps : 0|16@1- (1,0) [-73.2|80.3] "deg" Vector__XXX

CM_ SG_ 2281701504 apps "Accelerator pedal position sensor";
CM_ SG_ 2218983424 speed "Inverter 3 Speed";
CM_ SG_ 2281767040 bse "Break system encoder";
CM_ SG_ 2281832576 sps "Steering position sensor (-: right, +: left)";
BA_DEF_  "BusType" STRING ;
BA_DEF_DEF_  "BusType" "CAN";
